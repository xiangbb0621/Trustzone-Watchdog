## build/zynqmp/fitImage-zynqmp-zcu102.its
```
/dts-v1/;

/ {
    description = "U-Boot fitImage for plnx_aarch64 kernel";
    #address-cells = <1>;

    images {
        kernel {
            description = "Linux Kernel";
            data = /incbin/("./../../linux-xlnx/arch/arm64/boot/Image");
            type = "kernel";
            arch = "arm64";
            os = "linux";
            compression = "none";
            load = <0x80000>;
            entry = <0x80000>;
            hash@1 {
                algo = "sha1";
            };
        };
        fdt-1 {
            description = "Flattened Device Tree blob";
            // data = /incbin/("../../u-boot-xlnx/arch/arm/dts/zynqmp-zcu102-rev1.0.dtb");
            data = /incbin/("./bsp/zcu102.dtb");
            type = "flat_dt";
            arch = "arm64";
            load = <0x0E000000>;
            compression = "none";
            hash@1 {
                algo = "sha1";
            };
        };
        fdt-2 {
            description = "Flattened Device Tree overlay";
            data = /incbin/("zynqmp-optee.dtbo");
            type = "flat_dt";
            arch = "arm64";
            load = <0x0F000000>;
            compression = "none";
            hash@1 {
                algo = "sha1";
            };
        };
        ramdisk {
            description = "ramdisk";
            data = /incbin/("../../out-br/images/rootfs.cpio.gz");
            type = "ramdisk";
            arch = "arm64";
            os = "linux";
            compression = "none";
            hash@1 {
                algo = "sha1";
            };
        };
    };
    configurations {
        default = "conf@1";
        conf@1 {
            description = "Boot Linux kernel with FDT blob + ramdisk";
            kernel = "kernel";
            fdt = "fdt-1", "fdt-2";
            ramdisk = "ramdisk";
            hash@1 {
                algo = "sha1";
            };
        };
    };
};
```
